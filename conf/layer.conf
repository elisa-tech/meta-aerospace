## conf/layer.conf
```bitbake
# We have a conf and classes directory, add to BBPATH
BBPATH .= ":${LAYERDIR}"

# We have recipes-* directories, add to BBFILES
BBFILES += "${LAYERDIR}/recipes-*/*/*.bb \
            ${LAYERDIR}/recipes-*/*/*.bbappend"

BBFILE_COLLECTIONS += "meta-aerospace"
BBFILE_PATTERN_meta-aerospace = "^${LAYERDIR}/"
BBFILE_PRIORITY_meta-aerospace = "6"

LAYERDEPENDS_meta-aerospace = "core"
LAYERSERIES_COMPAT_meta-aerospace = "scarthgap"
```
